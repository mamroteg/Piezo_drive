/* USER CODE BEGIN Header */
/**
  ******************************************************************************
  * @file           : main.c
  * @brief          : Main program body
  ******************************************************************************
  * @attention
  *
  * Copyright (c) 2024 STMicroelectronics.
  * All rights reserved.
  *
  * This software is licensed under terms that can be found in the LICENSE file
  * in the root directory of this software component.
  * If no LICENSE file comes with this software, it is provided AS-IS.
  *
  ******************************************************************************
  */
/* USER CODE END Header */
/* Includes ------------------------------------------------------------------*/
#include "main.h"

/* Private includes ----------------------------------------------------------*/
/* USER CODE BEGIN Includes */
#include "stdbool.h"
/* USER CODE END Includes */

/* Private typedef -----------------------------------------------------------*/
/* USER CODE BEGIN PTD */

/* USER CODE END PTD */

/* Private define ------------------------------------------------------------*/
/* USER CODE BEGIN PD */
#define Pi 3.1415926
#define lutLen 2048			//Length of the full period
/* USER CODE END PD */

/* Private macro -------------------------------------------------------------*/
/* USER CODE BEGIN PM */

/* USER CODE END PM */

/* Private variables ---------------------------------------------------------*/
ADC_HandleTypeDef hadc1;

DAC_HandleTypeDef hdac1;
DAC_HandleTypeDef hdac2;

HRTIM_HandleTypeDef hhrtim1;

TIM_HandleTypeDef htim6;

/* USER CODE BEGIN PV */
uint8_t spd = 30;
uint8_t channel = 1;
bool gateOn = false;
bool buttonPress = false;
bool buttonRelease = false;
bool backwards = false;
bool pulse = false;
bool endPoint = false;
bool bootCharging = false;
uint16_t phaseAccumulator = 0;
uint8_t phaseIncrement;
uint8_t pulseLen;
uint16_t pulseAccumulator = 0;
float amplitude;
float offset;
uint16_t phaseShift;
const uint16_t *Lut;
uint16_t periodLen;
uint32_t stepNumber;
uint32_t stepCounter = 0;

//Two full sine periods
const uint16_t sinLut[2*lutLen] = {
32767,32868,32968,33069,33169,33270,33370,33471,
33571,33672,33772,33873,33973,34074,34174,34274,
34375,34475,34576,34676,34776,34877,34977,35077,
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31963,32063,32164,32264,32365,32465,32566,32666 };

/** Generated using Dr LUT - Free Lookup Table Generator
 * https://github.com/ppelikan/drlut
 **/
// Formula: 4*abs(t/T-floor(t/T+1/2))-1
const uint16_t sawLut[lutLen] = {
   0,   64,  128,  192,  256,  320,  384,  448,
 512,  576,  640,  704,  768,  832,  896,  960,
1024, 1088, 1152, 1216, 1280, 1344, 1408, 1472,
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 512,  448,  384,  320,  256,  192,  128,   64 };

/* USER CODE END PV */

/* Private function prototypes -----------------------------------------------*/
void SystemClock_Config(void);
static void MX_GPIO_Init(void);
static void MX_ADC1_Init(void);
static void MX_HRTIM1_Init(void);
static void MX_DAC1_Init(void);
static void MX_DAC2_Init(void);
static void MX_TIM6_Init(void);
/* USER CODE BEGIN PFP */
void DAC_Start();
void DAC_Stop();
void DAC_Set();
void Gate_Toggle_L();
void Gate_Toggle_H();
void initialize_dds();
void Speed_LED();
void Channel_LED();
void EndPoint_Handle();
/* USER CODE END PFP */

/* Private user code ---------------------------------------------------------*/
/* USER CODE BEGIN 0 */
void HAL_GPIO_EXTI_Callback(uint16_t GPIO_Pin)
{
	switch (GPIO_Pin) {
		case Channel_Select_Pin:
			DAC_Stop();
			channel++;
			if(channel > 3)
				channel -= 3;
			Channel_LED();
			DAC_Start();
			break;
		case Speed_Pin:
			spd++;
			if(spd > 3)
				spd = 0;
//			initialize_dds();
			Speed_LED();
			break;
		case Forward_Pin:
			if(HAL_GPIO_ReadPin(Forward_GPIO_Port, Forward_Pin) == 1)
			{
				backwards = false;
				buttonRelease = false;
//				EndPoint_Handle();
				initialize_dds();
//				DAC_Start();
				buttonPress = true;
			}
			else if(HAL_GPIO_ReadPin(Forward_GPIO_Port, Forward_Pin) == 0)
				buttonRelease = true;
			break;
		case Backward_Pin:
			if(HAL_GPIO_ReadPin(Backward_GPIO_Port, Backward_Pin) == 1)
			{
				backwards = true;
				buttonRelease = false;
//				EndPoint_Handle();
				initialize_dds();
//				DAC_Start();
				buttonPress = true;
			}
			else if(HAL_GPIO_ReadPin(Backward_GPIO_Port, Backward_Pin) == 0)
				buttonRelease = true;
			break;
		default:
//			endPoint = true;
//			EndPoint_Handle();
			break;
	}
}

void HAL_TIM_PeriodElapsedCallback(TIM_HandleTypeDef *htim)
{
		if(htim == &htim6 && gateOn == false && ((buttonPress == true && stepNumber == 0) || ((stepCounter <= stepNumber) && stepNumber != 0)))
		{
//			DAC_Set();
			phaseAccumulator += phaseIncrement;
			if (phaseAccumulator >= periodLen)
			{
				phaseAccumulator = 0;
				if(pulse == true)
				{
					Gate_Toggle_L();
					gateOn = true;
				}
				else if(endPoint == true || (buttonRelease == true && stepNumber == 0) || ((stepCounter == stepNumber) && stepNumber != 0))
				{
//					DAC_Stop();
					HAL_DAC_SetValue(&hdac1, DAC_CHANNEL_1, DAC_ALIGN_12B_L, 0);
					buttonPress = false;
//					endPoint = false;
					stepCounter = 0;
					stepNumber = 0;

				}
				else
					stepCounter++;
			}
			DAC_Set();
		}
		else if(htim == &htim6 && gateOn == true)
		{
			pulseAccumulator ++;
			if(pulseAccumulator >= pulseLen-1 && backwards == true && bootCharging == true)
			{
				Gate_Toggle_L();
				Gate_Toggle_H();
			}
			else if(pulseAccumulator >= pulseLen)
			{
				pulseAccumulator = 0;
				if(backwards == true)
					Gate_Toggle_H();
				else
					Gate_Toggle_L();
				gateOn = false;
				stepCounter ++;
				if(endPoint == true || (buttonRelease == true && stepNumber == 0) || ((stepCounter == stepNumber) && stepNumber != 0))
				{
					buttonPress = false;
//					DAC_Stop();
					HAL_DAC_SetValue(&hdac1, DAC_CHANNEL_1, DAC_ALIGN_12B_L, 0);
//					endPoint = false;
					stepCounter = 0;
					stepNumber = 0;
				}
			}
		}
}

void DAC_Start()
{
	switch (channel) {
		case 1:
			HAL_DAC_Start(&hdac1, DAC_CHANNEL_1);
			break;
		case 2:
			HAL_DAC_Start(&hdac1, DAC_CHANNEL_2);
			break;
		case 3:
			HAL_DAC_Start(&hdac2, DAC_CHANNEL_1);
			break;
	}
}

void DAC_Stop()
{
	switch (channel) {
		case 1:
			HAL_DAC_Stop(&hdac1, DAC_CHANNEL_1);
			break;
		case 2:
			HAL_DAC_Stop(&hdac1, DAC_CHANNEL_2);
			break;
		case 3:
			HAL_DAC_Stop(&hdac2, DAC_CHANNEL_1);
			break;
	}
}

void DAC_Set()
{
	uint16_t dacValue = Lut[phaseAccumulator + phaseShift] * amplitude + offset;
	switch (channel) {
		case 1:
			HAL_DAC_SetValue(&hdac1, DAC_CHANNEL_1, DAC_ALIGN_12B_L, dacValue);
			break;
		case 2:
			HAL_DAC_SetValue(&hdac1, DAC_CHANNEL_2, DAC_ALIGN_12B_L, dacValue);
			break;
		case 3:
			HAL_DAC_SetValue(&hdac2, DAC_CHANNEL_1, DAC_ALIGN_12B_L, dacValue);
			break;
	}
}

void Gate_Toggle_L()
{
	switch (channel) {
		case 1:
			HAL_GPIO_TogglePin(Gate_LI1_GPIO_Port, Gate_LI1_Pin);
			break;
		case 2:
			HAL_GPIO_TogglePin(Gate_LI2_GPIO_Port, Gate_LI2_Pin);
			break;
		case 3:
			HAL_GPIO_TogglePin(Gate_LI3_GPIO_Port, Gate_LI3_Pin);
			break;
	}
	bootCharging = !bootCharging;
}

void Gate_Toggle_H()
{
	switch (channel) {
		case 1:
				HAL_GPIO_TogglePin(Gate_HI1_GPIO_Port, Gate_HI1_Pin);
			break;
		case 2:
				HAL_GPIO_TogglePin(Gate_HI2_GPIO_Port, Gate_HI2_Pin);
			break;
		case 3:
				HAL_GPIO_TogglePin(Gate_HI3_GPIO_Port, Gate_HI3_Pin);
			break;
	}
}

void Speed_LED()
{
	switch (spd) {
		case 0:
			HAL_GPIO_WritePin(LED_SPD1_GPIO_Port, LED_SPD1_Pin, GPIO_PIN_RESET);
			HAL_GPIO_WritePin(LED_SPD2_GPIO_Port, LED_SPD2_Pin, GPIO_PIN_RESET);
			HAL_GPIO_WritePin(LED_SPD3_GPIO_Port, LED_SPD3_Pin, GPIO_PIN_RESET);
			break;
		case 1:
			HAL_GPIO_WritePin(LED_SPD1_GPIO_Port, LED_SPD1_Pin, GPIO_PIN_SET);
			break;
		case 2:
			HAL_GPIO_WritePin(LED_SPD1_GPIO_Port, LED_SPD1_Pin, GPIO_PIN_SET);
			HAL_GPIO_WritePin(LED_SPD2_GPIO_Port, LED_SPD2_Pin, GPIO_PIN_SET);
			break;
		case 3:
			HAL_GPIO_WritePin(LED_SPD1_GPIO_Port, LED_SPD1_Pin, GPIO_PIN_SET);
			HAL_GPIO_WritePin(LED_SPD2_GPIO_Port, LED_SPD2_Pin, GPIO_PIN_SET);
			HAL_GPIO_WritePin(LED_SPD3_GPIO_Port, LED_SPD3_Pin, GPIO_PIN_SET);
			break;
	}
}
void Channel_LED()
{
	switch (channel) {
		case 1:
			HAL_GPIO_WritePin(LED_CH3_GPIO_Port, LED_CH3_Pin, GPIO_PIN_RESET);
			HAL_GPIO_WritePin(LED_CH1_GPIO_Port, LED_CH1_Pin, GPIO_PIN_SET);
			break;
		case 2:
			HAL_GPIO_WritePin(LED_CH1_GPIO_Port, LED_CH1_Pin, GPIO_PIN_RESET);
			HAL_GPIO_WritePin(LED_CH2_GPIO_Port, LED_CH2_Pin, GPIO_PIN_SET);
			break;
		case 3:
			HAL_GPIO_WritePin(LED_CH2_GPIO_Port, LED_CH2_Pin, GPIO_PIN_RESET);
			HAL_GPIO_WritePin(LED_CH3_GPIO_Port, LED_CH3_Pin, GPIO_PIN_SET);
			break;
	}
}

void EndPoint_Handle()
{

}

void initialize_dds()
{
	float ph;				//Phase shift [0-2*Pi]
	uint16_t freq;			//Frequency of the generated signal [Hz]
	float ampl;				//Peak to peak voltage of the generated signal [V]
	float off;				//Offset [V]
	float period;			//Fraction of the full period to be generated [0-1]
	float pls;				//Fraction of the generated signal to be the pulse duration [0-1]
//	uint16_t timeOn = 0;	//Time of the output signal generation [ms]. When set to 0, the signal is generated only while the button is kept pressed
//	float stepLen;

	pulse = false;	//Preset flag

	switch (spd) {
		case 0:
			ph = 0;
			if(backwards == true)
			{
				ph = Pi;
				stepNumber = 3200;
			}
			else
				stepNumber = 3295/1.6;
			freq = 1100;
			ampl = 2.9*.91;//3.17;//3.115;
			off = .08;//.125;
			period = .5;
			pls = .1;
			Lut = sawLut;
			break;
		case 1:
			ph = 0;
			if(backwards == true)
				ph = Pi;
			freq = 1250;
			ampl = 2.9*.91;
			off = .08;
			period = .5;
			pls = .1;
			Lut = sawLut;
//			timeOn = 500;
			break;
		case 2:
			ph = 3*Pi/2;
			if(backwards == true)
				ph = Pi/2;
			freq = 6600;
			ampl = 3.17*.826;
			off = .08;
			period = .5;
			pls = .1;
			Lut = sinLut;
			break;
		case 3:
			ph = 3*Pi/2;
			if(backwards == true)
				ph = Pi/2;
			freq = 1100;
			ampl = 3.235*2*.826;
			off = .0815;
			if(backwards == true)
				off += .636;
			period = .25;
			pls = .1;
			Lut = sinLut;
			break;
	}

	stepNumber = 0;
	if(pls > 0)
		pulse = true;
	periodLen = lutLen * period;
	phaseIncrement = (freq / 140625.0)*periodLen;
	amplitude = (ampl / 3.3);
	offset = (off * 65534)/3.3;
	phaseShift = (ph * lutLen)/(2 * Pi);
	pulseLen = (periodLen/phaseIncrement)*pls;
//	stepLen = 1000*((periodLen / phaseIncrement) + pulseLen)/140625.0;	//milliseconds
//	stepNumber = timeOn / stepLen;	//Number of steps needed to elapse set time. Can also be set manually here
	phaseAccumulator = 0;
}
/* USER CODE END 0 */

/**
  * @brief  The application entry point.
  * @retval int
  */
int main(void)
{

  /* USER CODE BEGIN 1 */

  /* USER CODE END 1 */

  /* MCU Configuration--------------------------------------------------------*/

  /* Reset of all peripherals, Initializes the Flash interface and the Systick. */
  HAL_Init();

  /* USER CODE BEGIN Init */

  /* USER CODE END Init */

  /* Configure the system clock */
  SystemClock_Config();

  /* USER CODE BEGIN SysInit */

  /* USER CODE END SysInit */

  /* Initialize all configured peripherals */
  MX_GPIO_Init();
  MX_ADC1_Init();
  MX_HRTIM1_Init();
  MX_DAC1_Init();
  MX_DAC2_Init();
  MX_TIM6_Init();
  /* USER CODE BEGIN 2 */
//  initialize_dds();
  Speed_LED();
  Channel_LED();
  HAL_TIM_Base_Start_IT(&htim6);
//  HAL_DAC_Start(&hdac1, DAC_CHANNEL_1);
  DAC_Start();

  /* USER CODE END 2 */

  /* Infinite loop */
  /* USER CODE BEGIN WHILE */
  while (1)
  {
    /* USER CODE END WHILE */

    /* USER CODE BEGIN 3 */
  }
  /* USER CODE END 3 */
}

/**
  * @brief System Clock Configuration
  * @retval None
  */
void SystemClock_Config(void)
{
  RCC_OscInitTypeDef RCC_OscInitStruct = {0};
  RCC_ClkInitTypeDef RCC_ClkInitStruct = {0};
  RCC_PeriphCLKInitTypeDef PeriphClkInit = {0};

  /** Initializes the RCC Oscillators according to the specified parameters
  * in the RCC_OscInitTypeDef structure.
  */
  RCC_OscInitStruct.OscillatorType = RCC_OSCILLATORTYPE_HSE;
  RCC_OscInitStruct.HSEState = RCC_HSE_BYPASS;
  RCC_OscInitStruct.HSEPredivValue = RCC_HSE_PREDIV_DIV1;
  RCC_OscInitStruct.HSIState = RCC_HSI_ON;
  RCC_OscInitStruct.PLL.PLLState = RCC_PLL_ON;
  RCC_OscInitStruct.PLL.PLLSource = RCC_PLLSOURCE_HSE;
  RCC_OscInitStruct.PLL.PLLMUL = RCC_PLL_MUL9;
  if (HAL_RCC_OscConfig(&RCC_OscInitStruct) != HAL_OK)
  {
    Error_Handler();
  }

  /** Initializes the CPU, AHB and APB buses clocks
  */
  RCC_ClkInitStruct.ClockType = RCC_CLOCKTYPE_HCLK|RCC_CLOCKTYPE_SYSCLK
                              |RCC_CLOCKTYPE_PCLK1|RCC_CLOCKTYPE_PCLK2;
  RCC_ClkInitStruct.SYSCLKSource = RCC_SYSCLKSOURCE_PLLCLK;
  RCC_ClkInitStruct.AHBCLKDivider = RCC_SYSCLK_DIV1;
  RCC_ClkInitStruct.APB1CLKDivider = RCC_HCLK_DIV2;
  RCC_ClkInitStruct.APB2CLKDivider = RCC_HCLK_DIV1;

  if (HAL_RCC_ClockConfig(&RCC_ClkInitStruct, FLASH_LATENCY_2) != HAL_OK)
  {
    Error_Handler();
  }
  PeriphClkInit.PeriphClockSelection = RCC_PERIPHCLK_HRTIM1|RCC_PERIPHCLK_ADC12;
  PeriphClkInit.Adc12ClockSelection = RCC_ADC12PLLCLK_DIV1;
  PeriphClkInit.Hrtim1ClockSelection = RCC_HRTIM1CLK_HCLK;
  if (HAL_RCCEx_PeriphCLKConfig(&PeriphClkInit) != HAL_OK)
  {
    Error_Handler();
  }
}

/**
  * @brief ADC1 Initialization Function
  * @param None
  * @retval None
  */
static void MX_ADC1_Init(void)
{

  /* USER CODE BEGIN ADC1_Init 0 */

  /* USER CODE END ADC1_Init 0 */

  ADC_MultiModeTypeDef multimode = {0};
  ADC_ChannelConfTypeDef sConfig = {0};

  /* USER CODE BEGIN ADC1_Init 1 */

  /* USER CODE END ADC1_Init 1 */

  /** Common config
  */
  hadc1.Instance = ADC1;
  hadc1.Init.ClockPrescaler = ADC_CLOCK_ASYNC_DIV1;
  hadc1.Init.Resolution = ADC_RESOLUTION_12B;
  hadc1.Init.ScanConvMode = ADC_SCAN_DISABLE;
  hadc1.Init.ContinuousConvMode = DISABLE;
  hadc1.Init.DiscontinuousConvMode = DISABLE;
  hadc1.Init.ExternalTrigConvEdge = ADC_EXTERNALTRIGCONVEDGE_NONE;
  hadc1.Init.ExternalTrigConv = ADC_SOFTWARE_START;
  hadc1.Init.DataAlign = ADC_DATAALIGN_RIGHT;
  hadc1.Init.NbrOfConversion = 1;
  hadc1.Init.DMAContinuousRequests = DISABLE;
  hadc1.Init.EOCSelection = ADC_EOC_SINGLE_CONV;
  hadc1.Init.LowPowerAutoWait = DISABLE;
  hadc1.Init.Overrun = ADC_OVR_DATA_OVERWRITTEN;
  if (HAL_ADC_Init(&hadc1) != HAL_OK)
  {
    Error_Handler();
  }

  /** Configure the ADC multi-mode
  */
  multimode.Mode = ADC_MODE_INDEPENDENT;
  if (HAL_ADCEx_MultiModeConfigChannel(&hadc1, &multimode) != HAL_OK)
  {
    Error_Handler();
  }

  /** Configure Regular Channel
  */
  sConfig.Channel = ADC_CHANNEL_11;
  sConfig.Rank = ADC_REGULAR_RANK_1;
  sConfig.SingleDiff = ADC_SINGLE_ENDED;
  sConfig.SamplingTime = ADC_SAMPLETIME_1CYCLE_5;
  sConfig.OffsetNumber = ADC_OFFSET_NONE;
  sConfig.Offset = 0;
  if (HAL_ADC_ConfigChannel(&hadc1, &sConfig) != HAL_OK)
  {
    Error_Handler();
  }
  /* USER CODE BEGIN ADC1_Init 2 */

  /* USER CODE END ADC1_Init 2 */

}

/**
  * @brief DAC1 Initialization Function
  * @param None
  * @retval None
  */
static void MX_DAC1_Init(void)
{

  /* USER CODE BEGIN DAC1_Init 0 */

  /* USER CODE END DAC1_Init 0 */

  DAC_ChannelConfTypeDef sConfig = {0};

  /* USER CODE BEGIN DAC1_Init 1 */

  /* USER CODE END DAC1_Init 1 */

  /** DAC Initialization
  */
  hdac1.Instance = DAC1;
  if (HAL_DAC_Init(&hdac1) != HAL_OK)
  {
    Error_Handler();
  }

  /** DAC channel OUT1 config
  */
  sConfig.DAC_Trigger = DAC_TRIGGER_T6_TRGO;
  sConfig.DAC_OutputBuffer = DAC_OUTPUTBUFFER_ENABLE;
  if (HAL_DAC_ConfigChannel(&hdac1, &sConfig, DAC_CHANNEL_1) != HAL_OK)
  {
    Error_Handler();
  }

  /** DAC channel OUT2 config
  */
  sConfig.DAC_OutputSwitch = DAC_OUTPUTSWITCH_ENABLE;
  if (HAL_DAC_ConfigChannel(&hdac1, &sConfig, DAC_CHANNEL_2) != HAL_OK)
  {
    Error_Handler();
  }
  /* USER CODE BEGIN DAC1_Init 2 */

  /* USER CODE END DAC1_Init 2 */

}

/**
  * @brief DAC2 Initialization Function
  * @param None
  * @retval None
  */
static void MX_DAC2_Init(void)
{

  /* USER CODE BEGIN DAC2_Init 0 */

  /* USER CODE END DAC2_Init 0 */

  DAC_ChannelConfTypeDef sConfig = {0};

  /* USER CODE BEGIN DAC2_Init 1 */

  /* USER CODE END DAC2_Init 1 */

  /** DAC Initialization
  */
  hdac2.Instance = DAC2;
  if (HAL_DAC_Init(&hdac2) != HAL_OK)
  {
    Error_Handler();
  }

  /** DAC channel OUT1 config
  */
  sConfig.DAC_Trigger = DAC_TRIGGER_T6_TRGO;
  sConfig.DAC_OutputSwitch = DAC_OUTPUTSWITCH_ENABLE;
  if (HAL_DAC_ConfigChannel(&hdac2, &sConfig, DAC_CHANNEL_1) != HAL_OK)
  {
    Error_Handler();
  }
  /* USER CODE BEGIN DAC2_Init 2 */

  /* USER CODE END DAC2_Init 2 */

}

/**
  * @brief HRTIM1 Initialization Function
  * @param None
  * @retval None
  */
static void MX_HRTIM1_Init(void)
{

  /* USER CODE BEGIN HRTIM1_Init 0 */

  /* USER CODE END HRTIM1_Init 0 */

  HRTIM_TimeBaseCfgTypeDef pTimeBaseCfg = {0};
  HRTIM_TimerCfgTypeDef pTimerCfg = {0};
  HRTIM_OutputCfgTypeDef pOutputCfg = {0};

  /* USER CODE BEGIN HRTIM1_Init 1 */

  /* USER CODE END HRTIM1_Init 1 */
  hhrtim1.Instance = HRTIM1;
  hhrtim1.Init.HRTIMInterruptResquests = HRTIM_IT_NONE;
  hhrtim1.Init.SyncOptions = HRTIM_SYNCOPTION_NONE;
  if (HAL_HRTIM_Init(&hhrtim1) != HAL_OK)
  {
    Error_Handler();
  }
  pTimeBaseCfg.Period = 0xFFFD;
  pTimeBaseCfg.RepetitionCounter = 0x00;
  pTimeBaseCfg.PrescalerRatio = HRTIM_PRESCALERRATIO_DIV1;
  pTimeBaseCfg.Mode = HRTIM_MODE_CONTINUOUS;
  if (HAL_HRTIM_TimeBaseConfig(&hhrtim1, HRTIM_TIMERINDEX_TIMER_C, &pTimeBaseCfg) != HAL_OK)
  {
    Error_Handler();
  }
  pTimerCfg.InterruptRequests = HRTIM_TIM_IT_NONE;
  pTimerCfg.DMARequests = HRTIM_TIM_DMA_NONE;
  pTimerCfg.DMASrcAddress = 0x0000;
  pTimerCfg.DMADstAddress = 0x0000;
  pTimerCfg.DMASize = 0x1;
  pTimerCfg.HalfModeEnable = HRTIM_HALFMODE_DISABLED;
  pTimerCfg.StartOnSync = HRTIM_SYNCSTART_DISABLED;
  pTimerCfg.ResetOnSync = HRTIM_SYNCRESET_DISABLED;
  pTimerCfg.DACSynchro = HRTIM_DACSYNC_NONE;
  pTimerCfg.PreloadEnable = HRTIM_PRELOAD_DISABLED;
  pTimerCfg.UpdateGating = HRTIM_UPDATEGATING_INDEPENDENT;
  pTimerCfg.BurstMode = HRTIM_TIMERBURSTMODE_MAINTAINCLOCK;
  pTimerCfg.RepetitionUpdate = HRTIM_UPDATEONREPETITION_DISABLED;
  pTimerCfg.PushPull = HRTIM_TIMPUSHPULLMODE_DISABLED;
  pTimerCfg.FaultEnable = HRTIM_TIMFAULTENABLE_NONE;
  pTimerCfg.FaultLock = HRTIM_TIMFAULTLOCK_READWRITE;
  pTimerCfg.DeadTimeInsertion = HRTIM_TIMDEADTIMEINSERTION_DISABLED;
  pTimerCfg.DelayedProtectionMode = HRTIM_TIMER_A_B_C_DELAYEDPROTECTION_DISABLED;
  pTimerCfg.UpdateTrigger = HRTIM_TIMUPDATETRIGGER_NONE;
  pTimerCfg.ResetTrigger = HRTIM_TIMRESETTRIGGER_NONE;
  pTimerCfg.ResetUpdate = HRTIM_TIMUPDATEONRESET_DISABLED;
  if (HAL_HRTIM_WaveformTimerConfig(&hhrtim1, HRTIM_TIMERINDEX_TIMER_C, &pTimerCfg) != HAL_OK)
  {
    Error_Handler();
  }
  pOutputCfg.Polarity = HRTIM_OUTPUTPOLARITY_HIGH;
  pOutputCfg.SetSource = HRTIM_OUTPUTSET_NONE;
  pOutputCfg.ResetSource = HRTIM_OUTPUTRESET_NONE;
  pOutputCfg.IdleMode = HRTIM_OUTPUTIDLEMODE_NONE;
  pOutputCfg.IdleLevel = HRTIM_OUTPUTIDLELEVEL_INACTIVE;
  pOutputCfg.FaultLevel = HRTIM_OUTPUTFAULTLEVEL_NONE;
  pOutputCfg.ChopperModeEnable = HRTIM_OUTPUTCHOPPERMODE_DISABLED;
  pOutputCfg.BurstModeEntryDelayed = HRTIM_OUTPUTBURSTMODEENTRY_REGULAR;
  if (HAL_HRTIM_WaveformOutputConfig(&hhrtim1, HRTIM_TIMERINDEX_TIMER_C, HRTIM_OUTPUT_TC1, &pOutputCfg) != HAL_OK)
  {
    Error_Handler();
  }
  /* USER CODE BEGIN HRTIM1_Init 2 */

  /* USER CODE END HRTIM1_Init 2 */
  HAL_HRTIM_MspPostInit(&hhrtim1);

}

/**
  * @brief TIM6 Initialization Function
  * @param None
  * @retval None
  */
static void MX_TIM6_Init(void)
{

  /* USER CODE BEGIN TIM6_Init 0 */

  /* USER CODE END TIM6_Init 0 */

  TIM_MasterConfigTypeDef sMasterConfig = {0};

  /* USER CODE BEGIN TIM6_Init 1 */

  /* USER CODE END TIM6_Init 1 */
  htim6.Instance = TIM6;
  htim6.Init.Prescaler = 32-1;
  htim6.Init.CounterMode = TIM_COUNTERMODE_UP;
  htim6.Init.Period = 16-1;
  htim6.Init.AutoReloadPreload = TIM_AUTORELOAD_PRELOAD_DISABLE;
  if (HAL_TIM_Base_Init(&htim6) != HAL_OK)
  {
    Error_Handler();
  }
  sMasterConfig.MasterOutputTrigger = TIM_TRGO_UPDATE;
  sMasterConfig.MasterSlaveMode = TIM_MASTERSLAVEMODE_DISABLE;
  if (HAL_TIMEx_MasterConfigSynchronization(&htim6, &sMasterConfig) != HAL_OK)
  {
    Error_Handler();
  }
  /* USER CODE BEGIN TIM6_Init 2 */

  /* USER CODE END TIM6_Init 2 */

}

/**
  * @brief GPIO Initialization Function
  * @param None
  * @retval None
  */
static void MX_GPIO_Init(void)
{
  GPIO_InitTypeDef GPIO_InitStruct = {0};
/* USER CODE BEGIN MX_GPIO_Init_1 */
/* USER CODE END MX_GPIO_Init_1 */

  /* GPIO Ports Clock Enable */
  __HAL_RCC_GPIOC_CLK_ENABLE();
  __HAL_RCC_GPIOF_CLK_ENABLE();
  __HAL_RCC_GPIOA_CLK_ENABLE();
  __HAL_RCC_GPIOB_CLK_ENABLE();

  /*Configure GPIO pin Output Level */
  HAL_GPIO_WritePin(GPIOC, Gate_HI1_Pin|Gate_LI1_Pin|Gate_HI2_Pin, GPIO_PIN_RESET);

  /*Configure GPIO pin Output Level */
  HAL_GPIO_WritePin(GPIOA, Gate_LI2_Pin|Gate_HI3_Pin, GPIO_PIN_RESET);

  /*Configure GPIO pin Output Level */
  HAL_GPIO_WritePin(GPIOB, Gate_LI3_Pin|LED_SPD1_Pin|LED_SPD3_Pin|LED_SPD2_Pin
                          |LED_CH3_Pin|LED_CH2_Pin|LED_CH1_Pin, GPIO_PIN_RESET);

  /*Configure GPIO pins : Gate_HI1_Pin Gate_LI1_Pin Gate_HI2_Pin */
  GPIO_InitStruct.Pin = Gate_HI1_Pin|Gate_LI1_Pin|Gate_HI2_Pin;
  GPIO_InitStruct.Mode = GPIO_MODE_OUTPUT_PP;
  GPIO_InitStruct.Pull = GPIO_NOPULL;
  GPIO_InitStruct.Speed = GPIO_SPEED_FREQ_LOW;
  HAL_GPIO_Init(GPIOC, &GPIO_InitStruct);

  /*Configure GPIO pins : Forward_Pin Backward_Pin */
  GPIO_InitStruct.Pin = Forward_Pin|Backward_Pin;
  GPIO_InitStruct.Mode = GPIO_MODE_IT_RISING_FALLING;
  GPIO_InitStruct.Pull = GPIO_NOPULL;
  HAL_GPIO_Init(GPIOA, &GPIO_InitStruct);

  /*Configure GPIO pins : Gate_LI2_Pin Gate_HI3_Pin */
  GPIO_InitStruct.Pin = Gate_LI2_Pin|Gate_HI3_Pin;
  GPIO_InitStruct.Mode = GPIO_MODE_OUTPUT_PP;
  GPIO_InitStruct.Pull = GPIO_NOPULL;
  GPIO_InitStruct.Speed = GPIO_SPEED_FREQ_LOW;
  HAL_GPIO_Init(GPIOA, &GPIO_InitStruct);

  /*Configure GPIO pins : Speed_Pin Channel_Select_Pin EndPoint3_2_Pin */
  GPIO_InitStruct.Pin = Speed_Pin|Channel_Select_Pin|EndPoint3_2_Pin;
  GPIO_InitStruct.Mode = GPIO_MODE_IT_RISING;
  GPIO_InitStruct.Pull = GPIO_NOPULL;
  HAL_GPIO_Init(GPIOA, &GPIO_InitStruct);

  /*Configure GPIO pins : Gate_LI3_Pin LED_SPD1_Pin LED_SPD3_Pin LED_SPD2_Pin
                           LED_CH3_Pin LED_CH2_Pin LED_CH1_Pin */
  GPIO_InitStruct.Pin = Gate_LI3_Pin|LED_SPD1_Pin|LED_SPD3_Pin|LED_SPD2_Pin
                          |LED_CH3_Pin|LED_CH2_Pin|LED_CH1_Pin;
  GPIO_InitStruct.Mode = GPIO_MODE_OUTPUT_PP;
  GPIO_InitStruct.Pull = GPIO_NOPULL;
  GPIO_InitStruct.Speed = GPIO_SPEED_FREQ_LOW;
  HAL_GPIO_Init(GPIOB, &GPIO_InitStruct);

  /*Configure GPIO pins : EndPoint3_1_Pin EndPoint2_2_Pin EndPoint2_1_Pin EndPoint1_2_Pin
                           EndPoint1_1_Pin */
  GPIO_InitStruct.Pin = EndPoint3_1_Pin|EndPoint2_2_Pin|EndPoint2_1_Pin|EndPoint1_2_Pin
                          |EndPoint1_1_Pin;
  GPIO_InitStruct.Mode = GPIO_MODE_IT_RISING;
  GPIO_InitStruct.Pull = GPIO_NOPULL;
  HAL_GPIO_Init(GPIOB, &GPIO_InitStruct);

  /* EXTI interrupt init*/
  HAL_NVIC_SetPriority(EXTI0_IRQn, 0, 0);
  HAL_NVIC_EnableIRQ(EXTI0_IRQn);

  HAL_NVIC_SetPriority(EXTI1_IRQn, 0, 0);
  HAL_NVIC_EnableIRQ(EXTI1_IRQn);

  HAL_NVIC_SetPriority(EXTI3_IRQn, 0, 0);
  HAL_NVIC_EnableIRQ(EXTI3_IRQn);

  HAL_NVIC_SetPriority(EXTI9_5_IRQn, 0, 0);
  HAL_NVIC_EnableIRQ(EXTI9_5_IRQn);

  HAL_NVIC_SetPriority(EXTI15_10_IRQn, 0, 0);
  HAL_NVIC_EnableIRQ(EXTI15_10_IRQn);

/* USER CODE BEGIN MX_GPIO_Init_2 */
/* USER CODE END MX_GPIO_Init_2 */
}

/* USER CODE BEGIN 4 */

/* USER CODE END 4 */

/**
  * @brief  This function is executed in case of error occurrence.
  * @retval None
  */
void Error_Handler(void)
{
  /* USER CODE BEGIN Error_Handler_Debug */
  /* User can add his own implementation to report the HAL error return state */
  __disable_irq();
  while (1)
  {
  }
  /* USER CODE END Error_Handler_Debug */
}

#ifdef  USE_FULL_ASSERT
/**
  * @brief  Reports the name of the source file and the source line number
  *         where the assert_param error has occurred.
  * @param  file: pointer to the source file name
  * @param  line: assert_param error line source number
  * @retval None
  */
void assert_failed(uint8_t *file, uint32_t line)
{
  /* USER CODE BEGIN 6 */
  /* User can add his own implementation to report the file name and line number,
     ex: printf("Wrong parameters value: file %s on line %d\r\n", file, line) */
  /* USER CODE END 6 */
}
#endif /* USE_FULL_ASSERT */
